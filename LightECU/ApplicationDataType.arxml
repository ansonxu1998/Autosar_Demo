AUTOSAR XML (schema 4-2-2)
package /ApplicationDataType
  app type ButtonState: category=VALUE, sw-calibration-access=READ-WRITE, compu-method=ButtonState
  app type LightType: category=VALUE
  app type LightState: category=VALUE
