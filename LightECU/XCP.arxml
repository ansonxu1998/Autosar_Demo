AUTOSAR XML (schema 4-2-2)
package /ETAS_Project/EcucModuleConfigurationValuess
  module config Xcp
    XcpConfig_0 (XcpConfig)
      XcpTransportLayer_CAN (XcpTransportLayer):
        XcpConsistency = ODT
        XcpDaqOverloadIndication = NO_OVERLOAD_INDICATION
        XcpFrameConcatenation = 0
        XcpIdentificationFieldType = ABSOLUTE
        XcpOdtOptimization = OM_DEFAULT
        XcpTimestampType = ONE_BYTE
        XcpDaqMemoryLimit = 4096
        XcpMaxCto = 8
        XcpMaxDto = 8
        XcpTransportLayerName = VCU_XCPONCAN
        XcpTransportLayerType = CAN
        XcpRxPdu_0 (XcpRxPdu): XcpRxPacketType=CMD, XcpRxPduRef=XCP_RX_CMD_Canif2XCP
        XcpTxPdu_0 (XcpTxPdu): XcpTxPacketType=RES_ERR_EV_SERV, XcpTxPduRef=XCP_TX_RES_XCP2Canif, XcpEventChannelRef=XcpEventChannel_EV0
      XcpEventChannel_EV0 (XcpEventChannel):
        XcpEventChannelName = EV0
        XcpEventChannelPriority = 1
        XcpEventChannelShortName = EV0
        XcpEventChannelTimeCycle = 1
        XcpEventChannelTimeUnit = TIMESTAMP_UNIT_1MS
        XcpEventChannelType = DAQ
    XcpGeneral_0 (XcpGeneral):
      XcpAddressExtension = 0
      XcpBlockTransferDownload = true
      XcpBlockTransferUpload = true
      XcpCalibrationCal = true
      XcpCommandChecksum = true
      XcpCommandGetCommModeInfo = 0
      XcpCommandGetDaqListMode = true
      XcpCommandGetId = true
      XcpCommandModifyBits = 0
      XcpCommandReadDaq = true
      XcpCommandUserCmd = true
      XcpCommandsGetDaqInfo = true
      XcpCommandsGetPagInfo = true
      XcpConnectTransportLayerCallout = 0
      XcpDaqMemoryLimitEmulationDevice = 0
      XcpDaqQueueFactor = 2.0
      XcpDaqRamShiftSize = 1024
      XcpDaqRamShifting = 0
      XcpDaqStimMemoryAccessByAppl = true
      XcpEventChannelScheduling = 0
      XcpMemoryReadProtection = false
      XcpMemoryWriteProtection = 0
      XcpMtaBlockSizeAlign = 1
      XcpOdtOptimizationErrorReaction = FALLBACK_TO_OM_DEFAULT
      XcpPageSwitchingPag = 0
      XcpResumeMode = 0
      XcpSecondSlaveInstance = 0
      XcpSeedAndKey = 0
      XcpStaticAddressTransformation = 0
      XcpStimQueueFactor = 3
      XcpSynchronousDataAcquisitionDaq = true
      XcpSynchronousDataStimulationStim = true
      XcpUploadDownloadMemoryAccessByAppl = 0
      XcpDevErrorDetect = false
      XcpProductLine = CSMOSAR
      XcpMainFunctionPeriod = 0.001
      XcpTimestampTicks = 1
      XcpTimestampUnit = TIMESTAMP_UNIT_100US
      XcpVersion = VERSION_1_1
      XcpVersionInfoApi = false
