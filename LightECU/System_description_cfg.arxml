AUTOSAR XML (schema 4-2-2)
package /Pkg_System_Cfg/Pkg_Pdus
  general purpose i pdu XCP_RX_CMD: length=8
  general purpose i pdu XCP_RX_Broadcast: length=8
  general purpose i pdu XCP_TX_DAQ2: length=8
  general purpose i pdu XCP_TX_DAQ1: length=8
  general purpose i pdu XCP_TX_DAQ0: length=8
  general purpose i pdu XCP_TX_RES: length=8
