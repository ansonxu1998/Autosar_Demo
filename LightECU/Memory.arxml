AUTOSAR XML (schema 4-2-2)
package /ETAS_Project/EcucModuleConfigurationValuess
  module config NvM
    NvMBlockDescriptor_0 (NvMBlockDescriptor):
      NvMBlockCrcType = NVM_CRC16
      NvMBlockUseAutoValidation = 0
      NvMBlockUseSyncMechanism = 0
      NvMCalcRamBlockCrc = 0
      NvMRbFirstReadDataMigration = 0
      NvMRbGenRteAdminPort = 0
      NvMRbGenRteServicePort = 1
      NvMRbInitBlockAtLayoutChange = 0
      NvMRbNoFallback = 0
      NvMRbRamInitUnconditional = 0
      NvMRbResistantToLayoutRemoval = 0
      NvMRbSelectBlockForFirstInitAll = 0
      NvMSelectBlockForReadAll = true
      NvMSelectBlockForWriteAll = true
      NvMBlockJobPriority = 1
      NvMBlockManagementType = NVM_BLOCK_NATIVE
      NvMBlockUseCrc = true
      NvMBlockWriteProt = true
      NvMMaxNumOfReadRetries = 0
      NvMMaxNumOfWriteRetries = 0
      NvMNvBlockNum = 1
      NvMNvBlockLength = 8
      NvMNvramDeviceId = 0
      NvMResistantToChangedSw = false
      NvMRomBlockNum = 0
      NvMStaticBlockIDCheck = false
      NvMWriteBlockOnce = false
      NvMWriteVerification = false
      NvMWriteVerificationDataSize = 0
    NvMBlockDescriptor_1 (NvMBlockDescriptor):
      NvMBlockCrcType = NVM_CRC16
      NvMBlockUseAutoValidation = 0
      NvMBlockUseSyncMechanism = 0
      NvMCalcRamBlockCrc = 0
      NvMRbFirstReadDataMigration = 0
      NvMRbGenRteAdminPort = 0
      NvMRbGenRteServicePort = 1
      NvMRbInitBlockAtLayoutChange = 0
      NvMRbNoFallback = 0
      NvMRbRamInitUnconditional = 0
      NvMRbResistantToLayoutRemoval = 0
      NvMRbSelectBlockForFirstInitAll = 0
      NvMSelectBlockForReadAll = 0
      NvMSelectBlockForWriteAll = 0
    NvMCommon_0 (NvMCommon):
      NvMBswMMultiBlockJobStatusInformation = 0
      NvMRbAuxInterface = 0
      NvMRbGenArxmlVersion = NVM_GEN_ARXML_VERSION_402
      NvMRbInitAtLayoutChange = 0
      NvMRbMainFunctionScheduling = NVM_RB_MAINFUNC_SCHEDULING_RTE_TIMED
      NvMRbRamInitCheck = NVM_RB_RAM_INIT_CHECK_NONE
      NvMRbRemoveNonResistantBlocks = true
      NvMRbReqMonitor = NVM_RB_REQ_MON_DISABLED
      NvMRbRuntimeRamBlockConfiguration = 0
      NvMRbSetWriteAllTriggerApi = 0
      NvMRepeatMirrorOperations = 0
      NvMSizeImmediateJobQueue = 1
      NvMApiConfigClass = NVM_API_CONFIG_CLASS_3
      NvMCompiledConfigId = 0
      NvMCrcNumOfBytes = 1
      NvMDevErrorDetect = true
      NvMDrvModeSwitch = false
      NvMDynamicConfiguration = false
      NvMJobPrioritization = false
      NvMMainFunctionCycleTime = 0.001
      NvMMainFunctionPeriod = 0.001
      NvMPollingMode = true
      NvMSetRamBlockStatusApi = true
      NvMSizeStandardJobQueue = 5
      NvMVersionInfoApi = false
  module config Fee
    FeeBlockConfiguration_0 (FeeBlockConfiguration): FeeRbDataFilterType=STATIC
    FeeGeneral_0 (FeeGeneral):
      FeeDevErrorDetect = true
      FeeIndex = 0
      FeePollingMode = true
      FeeRbActEraseSuspension = false
      FeeRbActSafetyChecks = true
      FeeRbActSurvivalEval = false
      FeeRbActUnknownBlockReorg = false
      FeeRbFsSelect = FS1
      FeeRbMachineType = MCU_RB_MANUAL_CFG
      FeeRbMaintainRedundantBlocks = true
      FeeRbPageBufferSize = 1024
      FeeRbReadForce = false
      FeeSetModeSupported = true
      FeeVersionInfoApi = false
      FeeVirtualPageSize = 16
      FeeRbSectorTable: FeeRbFastCacheInitActive=true, FeeRbHeaderRecheckActive=false, FlsRbPageSize=16
        FeeRbSector_0 (FeeRbSector): FlsRbSectorSize=4096
        FeeRbSector_1 (FeeRbSector): FlsRbSectorSize=4096
  module config MemIf
    MemIfGeneral_0 (MemIfGeneral): MemIfNumberOfDevices=1, MemIfRbFeeUsed=true, MemIfDevErrorDetect=true, MemIfVersionInfoApi=false
