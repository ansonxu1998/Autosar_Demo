AUTOSAR XML (schema 4-2-2)
package /CompuMethods
  compu method ButtonState: 1=ON, 0=OFF
