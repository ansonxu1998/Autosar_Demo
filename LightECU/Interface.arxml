AUTOSAR XML (schema 4-2-2)
package /Interface
  sender receiver interface SR_IF_SendLightState
    data DESendLightType: type=LightType
    data DESendLightState: type=LightState
  client server interface CS_IF_GetLightState
    operation ClientServerOperation_0
