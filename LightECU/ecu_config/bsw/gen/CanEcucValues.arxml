AUTOSAR XML (schema 4-2-2)
package /Can
  module config Can: implementation-config-variant=VARIANT-PRE-COMPILE
    CanGeneral:
      CanMainFunctionBusoffPeriod = 0.0010
      CanMainFunctionModePeriod = 0.0010
      CanMultiplexedTransmission = false
      CanVersionInfoApi = false
      CanIndex = 0
      CanPublicIcomSupport = false
      CanTimeoutDuration = 1
      CanDevErrorDetection = false
    CanConfigSet
      Can_Network_CANNODE_0 (CanController):
        CanBusoffProcessing = POLLING
        CanControllerActivation = true
        CanControllerBaseAddress = 0
        CanTxProcessing = POLLING
        CanWakeupFunctionalityAPI = false
        CanWakeupProcessing = POLLING
        CanWakeupSupport = false
        CanControllerId = 0
        CanRxProcessing = POLLING
        CanControllerDefaultBaudrate = Can_Network_CANNODE_0/Can_Network_CANNODE_0
        Can_Network_CANNODE_0 (CanControllerBaudrateConfig):
          CanControllerBaudRateConfigID = 1
          CanControllerBaudRate = 50
          CanControllerPropSeg = 0
          CanControllerSeg1 = 10
          CanControllerSeg2 = 0
          CanControllerSyncJumpWidth = 0
      9 x CanHardwareObject, all with CanHwObjectCount=1, CanHandleType=FULL, CanIdType=EXTENDED, CanControllerRef=CanConfigSet/Can_Network_CANNODE_0:
        Can_Network_CANNODE_0_Rx_Ext_MailBox_1: CanObjectType=RECEIVE, CanObjectId=0
          CanHwFilter: CanHwFilterCode=201926864, CanHwFilterMask=536870911
        Can_Network_CANNODE_0_Rx_Ext_MailBox_2: CanObjectType=RECEIVE, CanObjectId=1
          CanHwFilter: CanHwFilterCode=201795792, CanHwFilterMask=536870911
        Can_Network_CANNODE_0_Rx_Ext_MailBox_3: CanObjectType=RECEIVE, CanObjectId=2
          CanHwFilter: CanHwFilterCode=201861328, CanHwFilterMask=536870911
        Can_Network_CANNODE_0_Rx_Ext_MailBox_4: CanObjectType=RECEIVE, CanObjectId=3
          CanHwFilter: CanHwFilterCode=419402033, CanHwFilterMask=536870911
        Can_Network_CANNODE_0_Tx_Ext_MailBox_1: CanObjectType=TRANSMIT, CanObjectId=4
        Can_Network_CANNODE_0_Tx_Ext_MailBox_2: CanObjectType=TRANSMIT, CanObjectId=5
        Can_Network_CANNODE_0_Tx_Ext_MailBox_3: CanObjectType=TRANSMIT, CanObjectId=6
        Can_Network_CANNODE_0_Tx_Ext_MailBox_4: CanObjectType=TRANSMIT, CanObjectId=7
        Can_Network_CANNODE_0_Tx_Ext_MailBox_5: CanObjectType=TRANSMIT, CanObjectId=8
