AUTOSAR XML (schema 4-2-2)
package /ETAS_Project/EcucModuleConfigurationValuess
  module config ComM: implementation-config-variant=VARIANT-PRE-COMPILE
    ComMGeneral:
      ComMEcuGroupClassification = 0
      ComMModeLimitationEnabled = false
      ComMTMinFullComModeDuration = 0.01
      ComMVersionInfoApi = false
      ComMWakeupInhibitionEnabled = false
      ComMPncGatewayEnabled = false
      ComMPncSupport = false
      ComMResetAfterForcingNoComm = false
      ComMSynchronousWakeUp = false
      ComMRteEnabled = false
      ComMDevErrorDetect = false
    ComMConfigSet
      ComMUser_Can_Network_0_Channel (ComMUser)
      ComMChannel_Can_Network_0_Channel (ComMChannel):
        ComMMainFunctionPeriod = 0.01
        ComMFullCommRequestNotificationEnabled = false
        ComMNoCom = true
        ComMNoWakeUpInhibitionNvmStorage = false
        ComMNoWakeup = true
        ComMBusType = COMM_BUS_TYPE_CAN
        ComMNetworkManagement: ComMNmLightTimeout=10, ComMNmVariant=NONE, ComMPncNmRequest=false
        ComMUserPerChannel_Can_Network_0_Channel (ComMUserPerChannel): ComMUserChannel=ComMUser_Can_Network_0_Channel
  module config CanIf: implementation-config-variant=VARIANT-PRE-COMPILE
    CanIfInitCfg: CanIfInitCfgSet=0
      CanIfInitHohCfg
        4 x CanIfHrhCfg, all with CanIfHrhCanCtrlIdRef=Can_Network_CANNODE_0:
          Can_Network_CANNODE_0_Rx_Ext_MailBox_{1..4}: CanIfHrhIdSymRef=Can_Network_CANNODE_0_Rx_Ext_MailBox_{1..4}
        5 x CanIfHthCfg, all with CanIfHthCanCtrlIdRef=Can_Network_CANNODE_0:
          Can_Network_CANNODE_0_Tx_Ext_MailBox_{1..5}: CanIfHthIdSymRef=Can_Network_CANNODE_0_Tx_Ext_MailBox_{1..5}
        CanIfHrhCfg_0 (CanIfHrhCfg): CanIfHrhCanCtrlIdRef=Can_Network_CANNODE_0, CanIfHrhIdSymRef=Can_Network_CANNODE_0_Rx_Ext_MailBox_5
        XCP_Network_CANNODE_0_Tx_Ext_MailBox_5 (CanIfHthCfg): CanIfHthCanCtrlIdRef=Can_Network_CANNODE_0, CanIfHthIdSymRef=Can_Network_CANNODE_0_Tx_Ext_MailBox_5
      4 x CanIfRxPduCfg, all with CanIfRxPduReadData=false, CanIfRxPduReadNotifyStatus=true, CanIfRxPduCanIdType=EXTENDED_CAN, CanIfRxPduDlc=8, CanIfRxPduUserRxIndicationName=PduR_CanIfRxIndication, CanIfRxPduUserRxIndicationUL=PDUR:
        HCU_12_Can_Network_CANNODE_0: CanIfRxPduCanId=201926864, CanIfRxPduHrhIdRef=Can_Network_CANNODE_0_Rx_Ext_MailBox_1, CanIfRxPduRef=PduCollection/HCU_12_Can_Network_CANNODE_0_CanIf2PduR
        HCU_10_Can_Network_CANNODE_0: CanIfRxPduCanId=201795792, CanIfRxPduHrhIdRef=Can_Network_CANNODE_0_Rx_Ext_MailBox_2, CanIfRxPduRef=PduCollection/HCU_10_Can_Network_CANNODE_0_CanIf2PduR
        HCU_11_Can_Network_CANNODE_0: CanIfRxPduCanId=201861328, CanIfRxPduHrhIdRef=Can_Network_CANNODE_0_Rx_Ext_MailBox_3, CanIfRxPduRef=PduCollection/HCU_11_Can_Network_CANNODE_0_CanIf2PduR
        HCU_2_Can_Network_CANNODE_0: CanIfRxPduCanId=419402033, CanIfRxPduHrhIdRef=Can_Network_CANNODE_0_Rx_Ext_MailBox_4, CanIfRxPduRef=PduCollection/HCU_2_Can_Network_CANNODE_0_CanIf2PduR
      Buffer_Can_Network_CANNODE_0_Tx_Ext_MailBox_1 (CanIfBufferCfg): CanIfBufferSize=0, CanIfBufferHthRef=Can_Network_CANNODE_0_Tx_Ext_MailBox_1
      BMS_5_Can_Network_CANNODE_0 (CanIfTxPduCfg):
        CanIfTxPduReadNotifyStatus = false
        CanIfTxPduType = STATIC
        CanIfTxPduTruncation = false
        CanIfTxPduCanIdType = EXTENDED_CAN
        CanIfTxPduCanId = 404498676
        CanIfTxPduUserTxConfirmationUL = PDUR
        CanIfTxPduBufferRef = Buffer_Can_Network_CANNODE_0_Tx_Ext_MailBox_1
        CanIfTxPduRef = PduCollection/BMS_5_Can_Network_CANNODE_0_PduR2CanIf
      Buffer_Can_Network_CANNODE_0_Tx_Ext_MailBox_2 (CanIfBufferCfg): CanIfBufferSize=0, CanIfBufferHthRef=Can_Network_CANNODE_0_Tx_Ext_MailBox_2
      BMS_2_Can_Network_CANNODE_0 (CanIfTxPduCfg):
        CanIfTxPduReadNotifyStatus = false
        CanIfTxPduType = STATIC
        CanIfTxPduTruncation = false
        CanIfTxPduCanIdType = EXTENDED_CAN
        CanIfTxPduCanId = 402837748
        CanIfTxPduUserTxConfirmationUL = PDUR
        CanIfTxPduBufferRef = Buffer_Can_Network_CANNODE_0_Tx_Ext_MailBox_2
        CanIfTxPduRef = PduCollection/BMS_2_Can_Network_CANNODE_0_PduR2CanIf
      Buffer_Can_Network_CANNODE_0_Tx_Ext_MailBox_3 (CanIfBufferCfg): CanIfBufferSize=0, CanIfBufferHthRef=Can_Network_CANNODE_0_Tx_Ext_MailBox_3
      BMS_1_Can_Network_CANNODE_0 (CanIfTxPduCfg):
        CanIfTxPduReadNotifyStatus = false
        CanIfTxPduType = STATIC
        CanIfTxPduTruncation = false
        CanIfTxPduCanIdType = EXTENDED_CAN
        CanIfTxPduCanId = 402706676
        CanIfTxPduUserTxConfirmationUL = PDUR
        CanIfTxPduBufferRef = Buffer_Can_Network_CANNODE_0_Tx_Ext_MailBox_3
        CanIfTxPduRef = PduCollection/BMS_1_Can_Network_CANNODE_0_PduR2CanIf
      Buffer_Can_Network_CANNODE_0_Tx_Ext_MailBox_4 (CanIfBufferCfg): CanIfBufferSize=0, CanIfBufferHthRef=Can_Network_CANNODE_0_Tx_Ext_MailBox_4
      BMS_3_Can_Network_CANNODE_0 (CanIfTxPduCfg):
        CanIfTxPduReadNotifyStatus = false
        CanIfTxPduType = STATIC
        CanIfTxPduTruncation = false
        CanIfTxPduCanIdType = EXTENDED_CAN
        CanIfTxPduCanId = 404367604
        CanIfTxPduUserTxConfirmationUL = PDUR
        CanIfTxPduBufferRef = Buffer_Can_Network_CANNODE_0_Tx_Ext_MailBox_4
        CanIfTxPduRef = PduCollection/BMS_3_Can_Network_CANNODE_0_PduR2CanIf
      Buffer_Can_Network_CANNODE_0_Tx_Ext_MailBox_5 (CanIfBufferCfg): CanIfBufferSize=0, CanIfBufferHthRef=Can_Network_CANNODE_0_Tx_Ext_MailBox_5
      BMS_12_Can_Network_CANNODE_0 (CanIfTxPduCfg):
        CanIfTxPduReadNotifyStatus = false
        CanIfTxPduType = STATIC
        CanIfTxPduTruncation = false
        CanIfTxPduCanIdType = EXTENDED_CAN
        CanIfTxPduCanId = 419353844
        CanIfTxPduUserTxConfirmationUL = PDUR
        CanIfTxPduBufferRef = Buffer_Can_Network_CANNODE_0_Tx_Ext_MailBox_5
        CanIfTxPduRef = PduCollection/BMS_12_Can_Network_CANNODE_0_PduR2CanIf
      XCP_VCU_CMD_Flex_CAN0 (CanIfRxPduCfg):
        CanIfRxPduCanIdType = STANDARD_CAN
        CanIfRxPduDlc = 8
        CanIfRxPduReadData = true
        CanIfRxPduReadNotifyStatus = true
        CanIfRxPduCanId = 1552
        CanIfRxPduUserRxIndicationName = XCP_Rxindication
        CanIfRxPduUserRxIndicationUL = XCP
        CanIfRxPduRef = XCP_RX_CMD_Canif2XCP
        CanIfRxPduHrhIdRef = CanIfHrhCfg_0
      CanIfTxPduCfg_0 (CanIfTxPduCfg):
        CanIfTxPduCanId = 1553
        CanIfTxPduCanIdType = STANDARD_CAN
        CanIfTxPduReadNotifyStatus = true
        CanIfTxPduTruncation = true
        CanIfTxPduType = STATIC
        CanIfTxPduUserTxConfirmationUL = XCP
        CanIfTxPduUserTxConfirmationName = XCP_TxConfirmation
        CanIfTxPduBufferRef = Buffer_Can_Network_CANNODE_0_Tx_Ext_MailBox_5
        CanIfTxPduRef = XCP_RX_Broadcaset_Canif2XCP
    CanIfCtrlDrvCfg: CanIfRbCtrlDrvPrefix=CanConf_CanHardwareObject, CanIfCtrlDrvNameRef=CanGeneral, CanIfCtrlDrvInitHohConfigRef=CanIfInitHohCfg
      Can_Network_CANNODE_0 (CanIfCtrlCfg): CanIfCtrlWakeupSupport=false, CanIfCtrlCanCtrlRef=Can_Network_CANNODE_0
    CanIfDispatchCfg: CanIfDispatchUserCtrlBusOffUL=CAN_SM, CanIfDispatchUserCtrlModeIndicationUL=CAN_SM, CanIfDispatchUserTrcvModeIndicationName=CAN_SM
    CanIfPrivateCfg: CanIfPrivateDlcCheck=false
    CanIfPublicCfg:
      CanIfPublicReadRxPduDataApi = false
      CanIfPublicReadRxPduNotifyStatusApi = true
      CanIfPublicReadTxPduNotifyStatusApi = true
      CanIfPublicSetDynamicTxIdApi = false
      CanIfPublicTxBuffering = false
      CanIfPublicTxConfirmPollingSupport = false
      CanIfPublicVersionInfoApi = false
      CanIfPublicCancelTransmitSupport = false
      CanIfPublicErrorPassiveSupport = false
      CanIfPublicCanIfLiteConfiguration = false
      CanIfPublicUserTpTxInOfflineMode = false
      CanIfPublicWakeupCheckValidSupport = false
      CanIfPublicPnSupport = false
      CanIfPublicBusoffRecoveryfromRxIndication = false
      CanIfTriggerTransmitSupport = false
      CanIfTxOfflineActiveSupport = false
      CanIfWakeupSupport = false
      CanIfPublicDevErrorDetect = false
  module config CanSM: implementation-config-variant=VARIANT-PRE-COMPILE
    CanSMConfiguration: CanSMModeRequestRepetitionMax=5, CanSMModeRequestRepetitionTime=0.07
      CanSMManagerNetwork_Can_Network_0 (CanSMManagerNetwork):
        CanSMBorTxConfirmationPolling = false
        CanSMBorCounterL1ToL2 = 0
        CanSMBorTimeL1 = 0.04
        CanSMBorTimeL2 = 0.1
        CanSMBorTimeTxEnsured = 0.02
        CanSMComMNetworkHandleRef = ComMChannel_Can_Network_0_Channel
        CanSMDemEventParameterRefs: CanSMRbDynCreate_CANSM_E_BUS_OFF=Standard
        CanSMController_Can_Network_CANNODE_0 (CanSMController): CanSMControllerId=Can_Network_CANNODE_0
    CanSMGeneral: CanSMMainFunctionTimePeriod=0.01, CanSMVersionInfoApi=false, CanSMDevErrorDetect=false
  module config PduR: implementation-config-variant=VARIANT-PRE-COMPILE
    PduRGeneral:
      PduRVersionInfoApi = false
      PduRZeroCostOperation = false
      PduRFifoTxBufferSupport = false
      PduRIFGatewayOperation = false
      PduRTPGatewayOperation = false
      PduRMemorySize = 0
      PduRMinimumRoutingLoRxPduId = 0
      PduRMinimumRoutingLoTxPduId = 0
      PduRMinimumRoutingUpRxPduId = 0
      PduRMinimumRoutingUpTxPduId = 0
      PduRMulticastFromIfSupport = false
      PduRMulticastFromTpSupport = false
      PduRMulticastToIfSupport = false
      PduRMulticastToTpSupport = false
      PduRSbTxBufferSupport = false
      PduRQueueingSupport = false
      PduRCanTpChangeParameterRequestApi = false
      PduRFrTpChangeParameterRequestApi = false
      PduRGwTpWithLimitedBuffer = false
      PduRDevErrorDetect = false
    PduRRoutingTables: PduRConfigurationId=0
      PduRRoutingTable
        9 x PduRRoutingPath:
          HCU_12_Can_Network_CANNODE_0_CanIf2Com
            HCU_12_Can_Network_CANNODE_0_CanIf2PduR (PduRSrcPdu): PduRSrcPduRef=PduCollection/HCU_12_Can_Network_CANNODE_0_CanIf2PduR
            HCU_12_Can_Network_CANNODE_0_PduR2Com (PduRDestPdu): PduRTransmissionConfirmation=false, PduRDestPduRef=PduCollection/HCU_12_Can_Network_CANNODE_0_PduR2Com
          HCU_10_Can_Network_CANNODE_0_CanIf2Com
            HCU_10_Can_Network_CANNODE_0_CanIf2PduR (PduRSrcPdu): PduRSrcPduRef=PduCollection/HCU_10_Can_Network_CANNODE_0_CanIf2PduR
            HCU_10_Can_Network_CANNODE_0_PduR2Com (PduRDestPdu): PduRTransmissionConfirmation=false, PduRDestPduRef=PduCollection/HCU_10_Can_Network_CANNODE_0_PduR2Com
          HCU_11_Can_Network_CANNODE_0_CanIf2Com
            HCU_11_Can_Network_CANNODE_0_CanIf2PduR (PduRSrcPdu): PduRSrcPduRef=PduCollection/HCU_11_Can_Network_CANNODE_0_CanIf2PduR
            HCU_11_Can_Network_CANNODE_0_PduR2Com (PduRDestPdu): PduRTransmissionConfirmation=false, PduRDestPduRef=PduCollection/HCU_11_Can_Network_CANNODE_0_PduR2Com
          HCU_2_Can_Network_CANNODE_0_CanIf2Com
            HCU_2_Can_Network_CANNODE_0_CanIf2PduR (PduRSrcPdu): PduRSrcPduRef=PduCollection/HCU_2_Can_Network_CANNODE_0_CanIf2PduR
            HCU_2_Can_Network_CANNODE_0_PduR2Com (PduRDestPdu): PduRTransmissionConfirmation=false, PduRDestPduRef=PduCollection/HCU_2_Can_Network_CANNODE_0_PduR2Com
          BMS_5_Can_Network_CANNODE_0_Com2CanIf
            BMS_5_Can_Network_CANNODE_0_Com2PduR (PduRSrcPdu): PduRSrcPduRef=PduCollection/BMS_5_Can_Network_CANNODE_0_Com2PduR
            BMS_5_Can_Network_CANNODE_0_PduR2CanIf (PduRDestPdu): PduRTransmissionConfirmation=false, PduRDestPduRef=PduCollection/BMS_5_Can_Network_CANNODE_0_PduR2CanIf
          BMS_2_Can_Network_CANNODE_0_Com2CanIf
            BMS_2_Can_Network_CANNODE_0_Com2PduR (PduRSrcPdu): PduRSrcPduRef=PduCollection/BMS_2_Can_Network_CANNODE_0_Com2PduR
            BMS_2_Can_Network_CANNODE_0_PduR2CanIf (PduRDestPdu): PduRTransmissionConfirmation=false, PduRDestPduRef=PduCollection/BMS_2_Can_Network_CANNODE_0_PduR2CanIf
          BMS_1_Can_Network_CANNODE_0_Com2CanIf
            BMS_1_Can_Network_CANNODE_0_Com2PduR (PduRSrcPdu): PduRSrcPduRef=PduCollection/BMS_1_Can_Network_CANNODE_0_Com2PduR
            BMS_1_Can_Network_CANNODE_0_PduR2CanIf (PduRDestPdu): PduRTransmissionConfirmation=false, PduRDestPduRef=PduCollection/BMS_1_Can_Network_CANNODE_0_PduR2CanIf
          BMS_3_Can_Network_CANNODE_0_Com2CanIf
            BMS_3_Can_Network_CANNODE_0_Com2PduR (PduRSrcPdu): PduRSrcPduRef=PduCollection/BMS_3_Can_Network_CANNODE_0_Com2PduR
            BMS_3_Can_Network_CANNODE_0_PduR2CanIf (PduRDestPdu): PduRTransmissionConfirmation=false, PduRDestPduRef=PduCollection/BMS_3_Can_Network_CANNODE_0_PduR2CanIf
          BMS_12_Can_Network_CANNODE_0_Com2CanIf
            BMS_12_Can_Network_CANNODE_0_Com2PduR (PduRSrcPdu): PduRSrcPduRef=PduCollection/BMS_12_Can_Network_CANNODE_0_Com2PduR
            BMS_12_Can_Network_CANNODE_0_PduR2CanIf (PduRDestPdu): PduRTransmissionConfirmation=false, PduRDestPduRef=PduCollection/BMS_12_Can_Network_CANNODE_0_PduR2CanIf
    CanIf (PduRBswModules):
      PduRCancelReceive = 0
      PduRCancelTransmit = 0
      PduRChangeParameterApi = 0
      PduRCommunicationInterface = 1
      PduRLowerModule = 1
      PduRRetransmission = 0
      PduRTransportProtocol = 0
      PduRTriggertransmit = 0
      PduRTxConfirmation = 1
      PduRUpperModule = 0
      PduRUseTag = 0
      PduRBswModuleRef = CanIf
    Com (PduRBswModules):
      PduRCancelReceive = 0
      PduRCancelTransmit = 0
      PduRChangeParameterApi = 0
      PduRCommunicationInterface = 1
      PduRLowerModule = 0
      PduRRetransmission = 0
      PduRTransportProtocol = 1
      PduRTriggertransmit = 1
      PduRTxConfirmation = 0
      PduRUpperModule = 1
      PduRUseTag = 0
      PduRBswModuleRef = Com
  module config EcuC: implementation-config-variant=VARIANT-PRE-COMPILE
    EcucConfigSet
      PduCollection (EcucPduCollection): PduIdTypeEnum=uint16, PduLengthTypeEnum=uint16
        24 x Pdu:
          HCU_12_Can_Network_CANNODE_0_CanIf2PduR: PduLength=8
          HCU_12_Can_Network_CANNODE_0_PduR2Com: PduLength=8
          HCU_10_Can_Network_CANNODE_0_CanIf2PduR: PduLength=8
          HCU_10_Can_Network_CANNODE_0_PduR2Com: PduLength=8
          HCU_11_Can_Network_CANNODE_0_CanIf2PduR: PduLength=8
          HCU_11_Can_Network_CANNODE_0_PduR2Com: PduLength=8
          HCU_2_Can_Network_CANNODE_0_CanIf2PduR: PduLength=8
          HCU_2_Can_Network_CANNODE_0_PduR2Com: PduLength=8
          BMS_5_Can_Network_CANNODE_0_Com2PduR: PduLength=8
          BMS_5_Can_Network_CANNODE_0_PduR2CanIf: PduLength=8
          BMS_2_Can_Network_CANNODE_0_Com2PduR: PduLength=8
          BMS_2_Can_Network_CANNODE_0_PduR2CanIf: PduLength=8
          BMS_1_Can_Network_CANNODE_0_Com2PduR: PduLength=8
          BMS_1_Can_Network_CANNODE_0_PduR2CanIf: PduLength=8
          BMS_3_Can_Network_CANNODE_0_Com2PduR: PduLength=8
          BMS_3_Can_Network_CANNODE_0_PduR2CanIf: PduLength=8
          BMS_12_Can_Network_CANNODE_0_Com2PduR: PduLength=8
          BMS_12_Can_Network_CANNODE_0_PduR2CanIf: PduLength=8
          XCP_RX_Broadcaset_Canif2XCP: MetaDataLength=0
          XCP_RX_CMD_Canif2XCP: MetaDataLength=0
          XCP_TX_RES_XCP2Canif: MetaDataLength=0
          XCP_TX_DAQ{0..2}_XCP2Canif: MetaDataLength=0
    EcuCRbSettings: EcuCRbArRelease=AR42_Rev2, EcuCRbRteInUse=true
  module config Com: implementation-config-variant=VARIANT-PRE-COMPILE
    ComConfig_0 (ComConfig)
      ComTimeBase: ComGwTimeBase=0.005, ComRxTimeBase=0.01, ComTxTimeBase=0.01
      ComIPduGroup_Rx (ComIPduGroup)
      HCU_12_Can_Network_CANNODE_0 (ComIPdu):
        ComIPduSignalProcessing = IMMEDIATE
        ComIPduType = NORMAL
        ComIPduDirection = RECEIVE
        ComIPduGroupRef = ComIPduGroup_Rx
        ComPduIdRef = PduCollection/HCU_12_Can_Network_CANNODE_0_PduR2Com
        ComIPduSignalRef = HCU_VIN3Byte0
      HCU_VIN3Byte0 (ComSignal):
        ComSignalInitValue = 0
        ComSignalType = UINT8
        ComSignalEndianness = LITTLE_ENDIAN
        ComBitSize = 8
        ComBitPosition = 0
        ComUpdateBitPosition = -1
        ComTransferProperty = TRIGGERED
        ComSystemTemplateSystemSignalRef = HCU_VIN3Byte0
      HCU_10_Can_Network_CANNODE_0 (ComIPdu):
        ComIPduSignalProcessing = IMMEDIATE
        ComIPduType = NORMAL
        ComIPduDirection = RECEIVE
        ComIPduGroupRef = ComIPduGroup_Rx
        ComPduIdRef = PduCollection/HCU_10_Can_Network_CANNODE_0_PduR2Com
        ComIPduSignalRef = HCU_VIN1Byte7
        ComIPduSignalRef = HCU_VIN1Byte6
        ComIPduSignalRef = HCU_VIN1Byte5
        ComIPduSignalRef = HCU_VIN1Byte4
        ComIPduSignalRef = HCU_VIN1Byte3
        ComIPduSignalRef = HCU_VIN1Byte2
        ComIPduSignalRef = HCU_VIN1Byte1
        ComIPduSignalRef = HCU_VIN1Byte0
      8 x ComSignal, all with ComSignalInitValue=0, ComSignalType=UINT8, ComSignalEndianness=LITTLE_ENDIAN, ComBitSize=8, ComUpdateBitPosition=-1, ComTransferProperty=TRIGGERED:
        HCU_VIN1Byte7: ComBitPosition=56, ComSystemTemplateSystemSignalRef=HCU_VIN1Byte7
        HCU_VIN1Byte6: ComBitPosition=48, ComSystemTemplateSystemSignalRef=HCU_VIN1Byte6
        HCU_VIN1Byte5: ComBitPosition=40, ComSystemTemplateSystemSignalRef=HCU_VIN1Byte5
        HCU_VIN1Byte4: ComBitPosition=32, ComSystemTemplateSystemSignalRef=HCU_VIN1Byte4
        HCU_VIN1Byte3: ComBitPosition=24, ComSystemTemplateSystemSignalRef=HCU_VIN1Byte3
        HCU_VIN1Byte2: ComBitPosition=16, ComSystemTemplateSystemSignalRef=HCU_VIN1Byte2
        HCU_VIN1Byte1: ComBitPosition=8, ComSystemTemplateSystemSignalRef=HCU_VIN1Byte1
        HCU_VIN1Byte0: ComBitPosition=0, ComSystemTemplateSystemSignalRef=HCU_VIN1Byte0
      HCU_11_Can_Network_CANNODE_0 (ComIPdu):
        ComIPduSignalProcessing = IMMEDIATE
        ComIPduType = NORMAL
        ComIPduDirection = RECEIVE
        ComIPduGroupRef = ComIPduGroup_Rx
        ComPduIdRef = PduCollection/HCU_11_Can_Network_CANNODE_0_PduR2Com
        ComIPduSignalRef = HCU_VIN2Byte7
        ComIPduSignalRef = HCU_VIN2Byte6
        ComIPduSignalRef = HCU_VIN2Byte5
        ComIPduSignalRef = HCU_VIN2Byte4
        ComIPduSignalRef = HCU_VIN2Byte3
        ComIPduSignalRef = HCU_VIN2Byte2
        ComIPduSignalRef = HCU_VIN2Byte1
        ComIPduSignalRef = HCU_VIN2Byte0
      8 x ComSignal, all with ComSignalInitValue=0, ComSignalType=UINT8, ComSignalEndianness=LITTLE_ENDIAN, ComBitSize=8, ComUpdateBitPosition=-1, ComTransferProperty=TRIGGERED:
        HCU_VIN2Byte7: ComBitPosition=56, ComSystemTemplateSystemSignalRef=HCU_VIN2Byte7
        HCU_VIN2Byte6: ComBitPosition=48, ComSystemTemplateSystemSignalRef=HCU_VIN2Byte6
        HCU_VIN2Byte5: ComBitPosition=40, ComSystemTemplateSystemSignalRef=HCU_VIN2Byte5
        HCU_VIN2Byte4: ComBitPosition=32, ComSystemTemplateSystemSignalRef=HCU_VIN2Byte4
        HCU_VIN2Byte3: ComBitPosition=24, ComSystemTemplateSystemSignalRef=HCU_VIN2Byte3
        HCU_VIN2Byte2: ComBitPosition=16, ComSystemTemplateSystemSignalRef=HCU_VIN2Byte2
        HCU_VIN2Byte1: ComBitPosition=8, ComSystemTemplateSystemSignalRef=HCU_VIN2Byte1
        HCU_VIN2Byte0: ComBitPosition=0, ComSystemTemplateSystemSignalRef=HCU_VIN2Byte0
      HCU_2_Can_Network_CANNODE_0 (ComIPdu):
        ComIPduSignalProcessing = IMMEDIATE
        ComIPduType = NORMAL
        ComIPduDirection = RECEIVE
        ComIPduGroupRef = ComIPduGroup_Rx
        ComPduIdRef = PduCollection/HCU_2_Can_Network_CANNODE_0_PduR2Com
        ComIPduSignalRef = Transcendental_mode
        ComIPduSignalRef = HCU_ChgWakeup
        ComIPduSignalRef = HCU_WakeupPow
        ComIPduSignalRef = TCU_fanUnlock
        ComIPduSignalRef = TCU_EVUnlock
        ComIPduSignalRef = CCVS2_PauseRES
        ComIPduSignalRef = HCU_KeyPosition
        ComIPduSignalRef = TCU_PTCUnlock
        ComIPduSignalRef = TCU_ACUnlock
        ComIPduSignalRef = HCU_ACCompressorWorkEnCmd
        ComIPduSignalRef = HCU_PwrOffAllow
        ComIPduSignalRef = HCU_DriveMode
        ComIPduSignalRef = HCU_CruiseSts
        ComIPduSignalRef = Fuel_range
        ComIPduSignalRef = Pure_electric_range
        ComIPduSignalRef = HCU_Cruise__Pause_sts
        ComIPduSignalRef = HCU_ChrgSts
        ComIPduSignalRef = BMS_charge_response
        ComIPduSignalRef = MCU2_MotorTempExtreOver
        ComIPduSignalRef = MCU1_MotorTempExtreOver
        ComIPduSignalRef = HCU_CruiseSpd
      21 x ComSignal, all with ComSignalInitValue=0, ComSignalEndianness=LITTLE_ENDIAN, ComUpdateBitPosition=-1, ComTransferProperty=TRIGGERED:
        Transcendental_mode: ComSignalType=UINT8, ComBitSize=2, ComBitPosition=62, ComSystemTemplateSystemSignalRef=Transcendental_mode
        HCU_ChgWakeup: ComSignalType=UINT8, ComBitSize=2, ComBitPosition=60, ComSystemTemplateSystemSignalRef=HCU_ChgWakeup
        HCU_WakeupPow: ComSignalType=UINT8, ComBitSize=2, ComBitPosition=58, ComSystemTemplateSystemSignalRef=HCU_WakeupPow
        TCU_fanUnlock: ComSignalType=UINT8, ComBitSize=2, ComBitPosition=56, ComSystemTemplateSystemSignalRef=TCU_fanUnlock
        TCU_EVUnlock: ComSignalType=BOOLEAN, ComBitSize=1, ComBitPosition=55, ComSystemTemplateSystemSignalRef=TCU_EVUnlock
        CCVS2_PauseRES: ComSignalType=UINT8, ComBitSize=2, ComBitPosition=53, ComSystemTemplateSystemSignalRef=CCVS2_PauseRES
        HCU_KeyPosition: ComSignalType=UINT8, ComBitSize=2, ComBitPosition=51, ComSystemTemplateSystemSignalRef=HCU_KeyPosition
        TCU_PTCUnlock: ComSignalType=BOOLEAN, ComBitSize=1, ComBitPosition=50, ComSystemTemplateSystemSignalRef=TCU_PTCUnlock
        TCU_ACUnlock: ComSignalType=BOOLEAN, ComBitSize=1, ComBitPosition=49, ComSystemTemplateSystemSignalRef=TCU_ACUnlock
        HCU_ACCompressorWorkEnCmd: ComSignalType=BOOLEAN, ComBitSize=1, ComBitPosition=48, ComSystemTemplateSystemSignalRef=HCU_ACCompressorWorkEnCmd
        HCU_PwrOffAllow: ComSignalType=UINT8, ComBitSize=2, ComBitPosition=46, ComSystemTemplateSystemSignalRef=HCU_PwrOffAllow
        HCU_DriveMode: ComSignalType=UINT8, ComBitSize=4, ComBitPosition=42, ComSystemTemplateSystemSignalRef=HCU_DriveMode
        HCU_CruiseSts: ComSignalType=UINT8, ComBitSize=2, ComBitPosition=40, ComSystemTemplateSystemSignalRef=HCU_CruiseSts
        Fuel_range: ComSignalType=UINT16, ComBitSize=16, ComBitPosition=24, ComSystemTemplateSystemSignalRef=Fuel_range
        Pure_electric_range: ComSignalType=UINT8, ComBitSize=8, ComBitPosition=16, ComSystemTemplateSystemSignalRef=Pure_electric_range
        HCU_Cruise__Pause_sts: ComSignalType=UINT8, ComBitSize=2, ComBitPosition=14, ComSystemTemplateSystemSignalRef=HCU_Cruise__Pause_sts
        HCU_ChrgSts: ComSignalType=UINT8, ComBitSize=2, ComBitPosition=12, ComSystemTemplateSystemSignalRef=HCU_ChrgSts
        BMS_charge_response: ComSignalType=UINT8, ComBitSize=2, ComBitPosition=10, ComSystemTemplateSystemSignalRef=BMS_charge_response
        MCU2_MotorTempExtreOver: ComSignalType=BOOLEAN, ComBitSize=1, ComBitPosition=9, ComSystemTemplateSystemSignalRef=MCU2_MotorTempExtreOver
        MCU1_MotorTempExtreOver: ComSignalType=BOOLEAN, ComBitSize=1, ComBitPosition=8, ComSystemTemplateSystemSignalRef=MCU1_MotorTempExtreOver
        HCU_CruiseSpd: ComSignalType=UINT8, ComBitSize=8, ComBitPosition=0, ComSystemTemplateSystemSignalRef=HCU_CruiseSpd
      ComIPduGroup_Tx (ComIPduGroup)
      BMS_5_Can_Network_CANNODE_0 (ComIPdu):
        ComIPduSignalProcessing = IMMEDIATE
        ComIPduType = NORMAL
        ComIPduDirection = SEND
        ComFirstTimeout = 0.1
        ComTimeout = 0.1
        ComIPduGroupRef = ComIPduGroup_Tx
        ComPduIdRef = PduCollection/BMS_5_Can_Network_CANNODE_0_Com2PduR
        ComIPduSignalRef = BMS_IC_MinCellTemp
        ComIPduSignalRef = BMS_IC_MaxCellTemp
        ComIPduSignalRef = BMS_IC_MaxCellVoltage
        ComIPduSignalRef = BMS_IC_MinCellVoltage
        ComTxIPdu: ComMinimumDelayTime=0.0, ComTxIPduUnusedAreasDefault=255
          ComTxModeTrue
            ComTxMode: ComTxModeTimePeriod=0.1, ComTxModeMode=PERIODIC, ComTxModeNumberOfRepetitions=0, ComTxModeRepetitionPeriod=0, ComTxModeTimeOffset=0.0
          ComTxModeFalse
            ComTxMode: ComTxModeTimePeriod=0.1, ComTxModeMode=PERIODIC, ComTxModeNumberOfRepetitions=0, ComTxModeRepetitionPeriod=0, ComTxModeTimeOffset=0.0
      4 x ComSignal, all with ComSignalInitValue=0, ComSignalEndianness=LITTLE_ENDIAN, ComUpdateBitPosition=-1, ComTransferProperty=TRIGGERED:
        BMS_IC_MinCellTemp: ComSignalType=UINT8, ComBitSize=8, ComBitPosition=40, ComSystemTemplateSystemSignalRef=BMS_IC_MinCellTemp
        BMS_IC_MaxCellTemp: ComSignalType=UINT8, ComBitSize=8, ComBitPosition=32, ComSystemTemplateSystemSignalRef=BMS_IC_MaxCellTemp
        BMS_IC_MaxCellVoltage: ComSignalType=UINT16, ComBitSize=16, ComBitPosition=16, ComSystemTemplateSystemSignalRef=BMS_IC_MaxCellVoltage
        BMS_IC_MinCellVoltage: ComSignalType=UINT16, ComBitSize=16, ComBitPosition=0, ComSystemTemplateSystemSignalRef=BMS_IC_MinCellVoltage
      BMS_2_Can_Network_CANNODE_0 (ComIPdu):
        ComIPduSignalProcessing = IMMEDIATE
        ComIPduType = NORMAL
        ComIPduDirection = SEND
        ComFirstTimeout = 0.1
        ComTimeout = 0.1
        ComIPduGroupRef = ComIPduGroup_Tx
        ComPduIdRef = PduCollection/BMS_2_Can_Network_CANNODE_0_Com2PduR
        ComIPduSignalRef = BMS_VCU_Life
        ComIPduSignalRef = BMS_FltCode
        ComIPduSignalRef = BMS_FltCount
        ComIPduSignalRef = BMS_VCU_DCChargeRelay_Req
        ComIPduSignalRef = BMS_ChrgSts
        ComIPduSignalRef = BMS_MainNegRelay_Crt
        ComIPduSignalRef = BMS_MainNegRelay_Sts
        ComIPduSignalRef = BMS_MaxDCOut_Current
        ComIPduSignalRef = BMS_MaxDCChrg_Current
        ComTxIPdu: ComMinimumDelayTime=0.0, ComTxIPduUnusedAreasDefault=255
          ComTxModeTrue
            ComTxMode: ComTxModeTimePeriod=0.1, ComTxModeMode=PERIODIC, ComTxModeNumberOfRepetitions=0, ComTxModeRepetitionPeriod=0, ComTxModeTimeOffset=0.0
          ComTxModeFalse
            ComTxMode: ComTxModeTimePeriod=0.1, ComTxModeMode=PERIODIC, ComTxModeNumberOfRepetitions=0, ComTxModeRepetitionPeriod=0, ComTxModeTimeOffset=0.0
      9 x ComSignal, all with ComSignalInitValue=0, ComSignalEndianness=LITTLE_ENDIAN, ComUpdateBitPosition=-1, ComTransferProperty=TRIGGERED:
        BMS_VCU_Life: ComSignalType=UINT8, ComBitSize=8, ComBitPosition=56, ComSystemTemplateSystemSignalRef=BMS_VCU_Life
        BMS_FltCode: ComSignalType=UINT8, ComBitSize=8, ComBitPosition=48, ComSystemTemplateSystemSignalRef=BMS_FltCode
        BMS_FltCount: ComSignalType=UINT8, ComBitSize=8, ComBitPosition=40, ComSystemTemplateSystemSignalRef=BMS_FltCount
        BMS_VCU_DCChargeRelay_Req: ComSignalType=UINT8, ComBitSize=2, ComBitPosition=38, ComSystemTemplateSystemSignalRef=BMS_VCU_DCChargeRelay_Req
        BMS_ChrgSts: ComSignalType=UINT8, ComBitSize=2, ComBitPosition=36, ComSystemTemplateSystemSignalRef=BMS_ChrgSts
        BMS_MainNegRelay_Crt: ComSignalType=UINT8, ComBitSize=2, ComBitPosition=34, ComSystemTemplateSystemSignalRef=BMS_MainNegRelay_Crt
        BMS_MainNegRelay_Sts: ComSignalType=UINT8, ComBitSize=2, ComBitPosition=32, ComSystemTemplateSystemSignalRef=BMS_MainNegRelay_Sts
        BMS_MaxDCOut_Current: ComSignalType=UINT16, ComBitSize=16, ComBitPosition=16, ComSystemTemplateSystemSignalRef=BMS_MaxDCOut_Current
        BMS_MaxDCChrg_Current: ComSignalType=UINT16, ComBitSize=16, ComBitPosition=0, ComSystemTemplateSystemSignalRef=BMS_MaxDCChrg_Current
      BMS_1_Can_Network_CANNODE_0 (ComIPdu):
        ComIPduSignalProcessing = IMMEDIATE
        ComIPduType = NORMAL
        ComIPduDirection = SEND
        ComFirstTimeout = 0.1
        ComTimeout = 0.1
        ComIPduGroupRef = ComIPduGroup_Tx
        ComPduIdRef = PduCollection/BMS_1_Can_Network_CANNODE_0_Com2PduR
        ComIPduSignalRef = BMS_charge_request
        ComIPduSignalRef = BMS_CC2
        ComIPduSignalRef = BMS_SOC
        ComIPduSignalRef = BMS_DC_Current
        ComIPduSignalRef = BMS_DCMainWireVolt
        ComTxIPdu: ComMinimumDelayTime=0.0, ComTxIPduUnusedAreasDefault=255
          ComTxModeTrue
            ComTxMode: ComTxModeTimePeriod=0.1, ComTxModeMode=PERIODIC, ComTxModeNumberOfRepetitions=0, ComTxModeRepetitionPeriod=0, ComTxModeTimeOffset=0.0
          ComTxModeFalse
            ComTxMode: ComTxModeTimePeriod=0.1, ComTxModeMode=PERIODIC, ComTxModeNumberOfRepetitions=0, ComTxModeRepetitionPeriod=0, ComTxModeTimeOffset=0.0
      5 x ComSignal, all with ComSignalInitValue=0, ComSignalEndianness=LITTLE_ENDIAN, ComUpdateBitPosition=-1, ComTransferProperty=TRIGGERED:
        BMS_charge_request: ComSignalType=UINT8, ComBitSize=2, ComBitPosition=42, ComSystemTemplateSystemSignalRef=BMS_charge_request
        BMS_CC2: ComSignalType=UINT8, ComBitSize=2, ComBitPosition=40, ComSystemTemplateSystemSignalRef=BMS_CC2
        BMS_SOC: ComSignalType=UINT8, ComBitSize=8, ComBitPosition=32, ComSystemTemplateSystemSignalRef=BMS_SOC
        BMS_DC_Current: ComSignalType=UINT16, ComBitSize=16, ComBitPosition=16, ComSystemTemplateSystemSignalRef=BMS_DC_Current
        BMS_DCMainWireVolt: ComSignalType=UINT16, ComBitSize=16, ComBitPosition=0, ComSystemTemplateSystemSignalRef=BMS_DCMainWireVolt
      BMS_3_Can_Network_CANNODE_0 (ComIPdu):
        ComIPduSignalProcessing = IMMEDIATE
        ComIPduType = NORMAL
        ComIPduDirection = SEND
        ComFirstTimeout = 0.1
        ComTimeout = 0.1
        ComIPduGroupRef = ComIPduGroup_Tx
        ComPduIdRef = PduCollection/BMS_3_Can_Network_CANNODE_0_Com2PduR
        ComIPduSignalRef = BMS_VCU_cooling_Sts
        ComIPduSignalRef = BMS_IC_Temp_Runaway
        ComIPduSignalRef = BMS_IC_Heating_Sts
        ComIPduSignalRef = BMS_IC_InsulationFlt_Levl
        ComIPduSignalRef = BMS_IC_SOCLower
        ComIPduSignalRef = BMS_IC_TempHigh
        ComIPduSignalRef = BMS_IC_SOCLow
        ComTxIPdu: ComMinimumDelayTime=0.0, ComTxIPduUnusedAreasDefault=255
          ComTxModeTrue
            ComTxMode: ComTxModeTimePeriod=0.1, ComTxModeMode=PERIODIC, ComTxModeNumberOfRepetitions=0, ComTxModeRepetitionPeriod=0, ComTxModeTimeOffset=0.0
          ComTxModeFalse
            ComTxMode: ComTxModeTimePeriod=0.1, ComTxModeMode=PERIODIC, ComTxModeNumberOfRepetitions=0, ComTxModeRepetitionPeriod=0, ComTxModeTimeOffset=0.0
      7 x ComSignal, all with ComSignalInitValue=0, ComSignalEndianness=LITTLE_ENDIAN, ComUpdateBitPosition=-1, ComTransferProperty=TRIGGERED:
        BMS_VCU_cooling_Sts: ComSignalType=UINT8, ComBitSize=2, ComBitPosition=50, ComSystemTemplateSystemSignalRef=BMS_VCU_cooling_Sts
        BMS_IC_Temp_Runaway: ComSignalType=BOOLEAN, ComBitSize=1, ComBitPosition=49, ComSystemTemplateSystemSignalRef=BMS_IC_Temp_Runaway
        BMS_IC_Heating_Sts: ComSignalType=UINT8, ComBitSize=2, ComBitPosition=46, ComSystemTemplateSystemSignalRef=BMS_IC_Heating_Sts
        BMS_IC_InsulationFlt_Levl: ComSignalType=UINT8, ComBitSize=2, ComBitPosition=41, ComSystemTemplateSystemSignalRef=BMS_IC_InsulationFlt_Levl
        BMS_IC_SOCLower: ComSignalType=BOOLEAN, ComBitSize=1, ComBitPosition=38, ComSystemTemplateSystemSignalRef=BMS_IC_SOCLower
        BMS_IC_TempHigh: ComSignalType=BOOLEAN, ComBitSize=1, ComBitPosition=37, ComSystemTemplateSystemSignalRef=BMS_IC_TempHigh
        BMS_IC_SOCLow: ComSignalType=BOOLEAN, ComBitSize=1, ComBitPosition=35, ComSystemTemplateSystemSignalRef=BMS_IC_SOCLow
      BMS_12_Can_Network_CANNODE_0 (ComIPdu):
        ComIPduSignalProcessing = IMMEDIATE
        ComIPduType = NORMAL
        ComIPduDirection = SEND
        ComFirstTimeout = 0.1
        ComTimeout = 0.1
        ComIPduGroupRef = ComIPduGroup_Tx
        ComPduIdRef = PduCollection/BMS_12_Can_Network_CANNODE_0_Com2PduR
        ComIPduSignalRef = BMS_VCU_Heating_Req
        ComTxIPdu: ComMinimumDelayTime=0.0, ComTxIPduUnusedAreasDefault=255
          ComTxModeTrue
            ComTxMode: ComTxModeTimePeriod=0.1, ComTxModeMode=PERIODIC, ComTxModeNumberOfRepetitions=0, ComTxModeRepetitionPeriod=0, ComTxModeTimeOffset=0.0
          ComTxModeFalse
            ComTxMode: ComTxModeTimePeriod=0.1, ComTxModeMode=PERIODIC, ComTxModeNumberOfRepetitions=0, ComTxModeRepetitionPeriod=0, ComTxModeTimeOffset=0.0
      BMS_VCU_Heating_Req (ComSignal):
        ComSignalInitValue = 0
        ComSignalType = UINT8
        ComSignalEndianness = LITTLE_ENDIAN
        ComBitSize = 2
        ComBitPosition = 20
        ComUpdateBitPosition = -1
        ComTransferProperty = TRIGGERED
        ComSystemTemplateSystemSignalRef = BMS_VCU_Heating_Req
    ComGeneral:
      ComVersionInfoApi = false
      ComCommonIPduTxPeriodFeature = false
      ComEnableJitterFilter = false
      ComEnableSignalGroupArrayApi = false
      ComCancellationSupport = false
      ComConfigurationUseDet = false
